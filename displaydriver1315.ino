//understandint twint- bsicly its a weird when its at 1 and we write 1 to it, it somehow goes to 0, so basicly twint is 1 we write 1 to it it becomes 0 and the operation we want begines but as soon it operation is done it becomes 1 again
#include <util/delay.h>
#define F_CPU 16000000UL
void i2c_init(){
  TWSR=0x00;// Prescaler = 1 (TWPS1:0 = 00)
  TWBR=((F_CPU/100000UL)-16)/2;//setting it to 100khz
 
}//setting frequenct of 100khz for i2c

uint8_t I2C_Start(uint8_t slave_addres,uint8_t read_write_bit){
  TWCR=(1<<TWSTA)|(1<<TWINT)| (1 << TWEN);
  // TWSTA: configure this operation as a start condition
// TWEN: keep TWI enabled
// TWINT: clear flag → this is what actually triggers the start condition to fire

  while(!(TWCR&(1<<TWINT)));//wait until twi does its current job(here start condition)
  
  uint8_t status=TWSR &0xF8;//the status is in the bit 7 to 3 of twsr
  if (status != 0x08 && status != 0x10) return status;//

  TWDR= (slave_addres<<1)|(read_write_bit&0x01);//basicly in i2c 1to7 bit is data and 0th bit is read or write

  TWCR=(1<<TWEN)|(1<<TWINT);//enable twi meaning telling it to do the job(here writting)
  while(!(TWCR&(1<<TWINT)));//wait until twi does its job(here writting)
  return (TWSR & 0xF8); // Returns status (0x18 = SLA+W ACK, 0x40 = SLA+R ACK)
}


void I2C_Stop(){
  TWCR=(1<<TWSTO)|(1<<TWINT)|(1<<TWEN);
  while (TWCR & (1<<TWSTO));   // wait until hardware auto-clears TWSTO as twint doesnt go back to 1 after stop
}

uint8_t I2C_Write(uint8_t data){
  TWDR=data;//copy data in TWD register
  TWCR=(1<<TWEN)|(1<<TWINT);//enable twi meaning telling it to do the job(here writting)
  while(!(TWCR&(1<<TWINT)));//wait until twi does its job(here writting)
  return (TWSR & 0xF8); // Returns 0x28 if Data byte transmitted & ACK received


}

#define SSD1315_I2C_ADDR 0x3C//slave addres


void ssd1315_cmd_stream(const uint8_t *cmds, uint8_t length) {
    I2C_Start(SSD1315_I2C_ADDR, 0); // 1. START
    I2C_Write(0x00);                // 2. Control Byte: Command Mode with continois flow (C0 = 0)[cite: 2]
    
    for (uint8_t i = 0; i < length; i++) {
        I2C_Write(cmds[i]);         // 3. Send commands con tinuously[cite: 2]
    }
    
    I2C_Stop();                     // 4. STOP once at the very end
}

void ssd1315_data_stream(const uint8_t *bufffer, uint16_t size){
  I2C_Start(SSD1315_I2C_ADDR, 0);
  I2C_Write(0x40);//setting data mode with continous flow
  for(uint16_t i=0;i<size;i++){
    I2C_Write(bufffer[i]);
  }
  I2C_Stop();

}

void ssd1315_init(){
  _delay_ms(10);
  
  static const uint8_t init_sequence[]={
      0xAE,//Turning display off
      0x20,0x00,//first Memory addres mode than telling it to go horizontal   
             // Horizontal Mode
     
      0xA1,//seg0 controls column0
      0xDA, 0x12, // Sets Alternative COM Pin Configuration[cite: 2]
      0xC0,//vertical scan from 0 to 63
      0xA8,0x3F,//telling it i am settting multiplex mode meaning telling it how many rows i am going to use than telling it 63 as in it its N+1
      0xD3,0x00, //setting display offset to 0
      0x8D,0x14,//voltage booster as pixels need high voltage than the supplied 
      0xAF//turn display ON


  };
  ssd1315_cmd_stream(init_sequence,sizeof(init_sequence));


}
uint8_t display_buffer[1024];
void ssd1315_clear_buffer(){
    for(uint16_t i=0;i<1024;i++){
      display_buffer[i]=0x00;
    }
    
  }

void ssd1315_update(){
  static const uint8_t reset[]={
    0x21,0x00,0x7F,
    0x22,0x00,0x07
  };
  ssd1315_cmd_stream(reset, sizeof(reset));
  ssd1315_data_stream(display_buffer, 1024); // Flushes 1024 bytes to screen
}

void ssd1315_draw_pixel(uint8_t x, uint8_t y,uint8_t color){
  if(x>=128||y>=64)return;
  uint16_t index = x + (y / 8) * 128;
  if (color) {

    display_buffer[index] |= (1 << (y % 8));  // Turn pixel ON

    } else {

      display_buffer[index] &= ~(1 << (y % 8)); // Turn pixel OFF
    }   
}
static void swap_u8(uint8_t *a, uint8_t *b){ uint8_t t=*a; *a=*b; *b=t; }
void drawlineH(uint8_t x0, uint8_t y0,uint8_t x1,uint8_t y1){
  int x,y;
  int p;
  if(x0>x1){
    swap_u8(&x0, &x1);
    swap_u8(&y0, &y1);

  }
  int dx= x1-x0;
  int dy=y1-y0;
  int dir=dy<0?-1:1;
  dy*=dir;

  if(dx!=0){
    y=y0;
    int p=2*dy-dx;
    for(int i=0;i<=dx;i++){
      ssd1315_draw_pixel(x0+i, 63-y, 1);
      if (p>0){
        y+=dir;
        p=p-2*dx;
      }
      p=p+2*dy;
    }
  }
}

void drawlineV(uint8_t x0, uint8_t y0,uint8_t x1,uint8_t y1){
  int x,y;
  int p;
  if(y0>y1){
    swap_u8(&x0, &x1);
    swap_u8(&y0, &y1);

  }
  int dx= x1-x0;
  int dy=y1-y0;
  int dir=dx<0?-1:1;
  dx*=dir;

  if(dy!=0){
    x=x0;
    int p=2*dx-dy;
    for(int i=0;i<=dy;i++){
      ssd1315_draw_pixel(x, 63-(-(y0+i)), 1);
      if (p>=0){
        x+=dir;
        p=p-2*dy;
      }
      p=p+2*dx;
    }
  }
  
}
void drawline(uint8_t x0, uint8_t y0,uint8_t x1,uint8_t y1){
  if(abs(x1-x0)>abs(y1-y0)){
    drawlineH(x0,  y0,  x1,  y1);
  }
  else{
    drawlineV(x0,  y0,  x1,  y1);
  }

}

void drawrectangle(uint8_t x,uint8_t y,uint8_t h, uint8_t w){
  drawline(x, y, x+w, y);
  drawline(x, y, x, y+h);
  drawline(x+w, y, x+w, y+h);
  drawline(x+w, y+h, x, y+h);

}
void drawfilledrectengle(uint8_t x,uint8_t y,uint8_t h, uint8_t w){
  for (int i=x;i<=x+w;i++){
    for(int j=y;j<=y+h;j++){
      ssd1315_draw_pixel(i, 63-j, 1);

    }
  }
}

void drawCircle1(uint8_t xc, uint8_t yc, uint8_t x, uint8_t y){
 
    

    ssd1315_draw_pixel(xc+x, 63-(yc+y), 1);
    ssd1315_draw_pixel(xc-x, 63-(yc+y), 1);
    ssd1315_draw_pixel(xc+x, 63-(yc-y), 1);
    ssd1315_draw_pixel(xc-x, 63-(yc-y), 1);
    ssd1315_draw_pixel(xc+y, 63-(yc+x), 1);
    ssd1315_draw_pixel(xc-y, 63-(yc+x), 1);
    ssd1315_draw_pixel(xc+y, 63-(yc-x), 1);
    ssd1315_draw_pixel(xc-y, 63-(yc-x), 1);
}
void DrawFilledCircle(uint8_t x0, uint8_t y0, uint8_t radius)
{
    int x = radius;
    int y = 0;
    int xChange = 1 - (radius << 1);
    int yChange = 0;
    int radiusError = 0;

    while (x >= y)
    {
        for (int i = x0 - x; i <= x0 + x; i++)
        {
            ssd1315_draw_pixel(i, 63-(y0 + y),1);
            ssd1315_draw_pixel(i,63- (y0 - y),1);
        }
        for (int i = x0 - y; i <= x0 + y; i++)
        {
            ssd1315_draw_pixel(i, 63-(y0 + x),1);
            ssd1315_draw_pixel(i, 63-(y0 - x),1);
        }

        y++;
        radiusError += yChange;
        yChange += 2;
        if (((radiusError << 1) + xChange) > 0)
        {
            x--;
            radiusError += xChange;
            xChange += 2;
        }
    }
}



void drawcircle(uint8_t xc, uint8_t yc, uint8_t r){
    
    int x = 0, y = r;
    int d = 3 - 2 * r;
    drawCircle1(xc, yc, x, y);
    while (y >= x){
      
        // check for decision parameter
        // and correspondingly 
        // update d, y
        if (d > 0) {
            y--; 
            d = d + 4 * (x - y) + 10;
        }
        else
            d = d + 4 * x + 6;

        // Increment x after updating decision parameter
        x++;
        
        // Draw the circle using the new coordinates
        drawCircle1(xc, yc, x, y);
        delay(50);
    }
}

void draw_c(uint8_t x,uint8_t y, unsigned char c){
  static const unsigned char font[] PROGMEM = {
    0x00, 0x00, 0x00, 0x00, 0x00, 0x3E, 0x5B, 0x4F, 0x5B, 0x3E, 0x3E, 0x6B,
    0x4F, 0x6B, 0x3E, 0x1C, 0x3E, 0x7C, 0x3E, 0x1C, 0x18, 0x3C, 0x7E, 0x3C,
    0x18, 0x1C, 0x57, 0x7D, 0x57, 0x1C, 0x1C, 0x5E, 0x7F, 0x5E, 0x1C, 0x00,
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    0x14, 0x08, 0x55, 0x00, 0x55, 0x00, 0x55, // #176 (25% block) missing in old
                                              // code
    0xAA, 0x55, 0xAA, 0x55, 0xAA,             // 50% block
    0xFF, 0x55, 0xFF, 0x55, 0xFF,             // 75% block
    0x00, 0x00, 0x00, 0xFF, 0x00, 0x10, 0x10, 0x10, 0xFF, 0x00, 0x14, 0x14,
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    0x3C, 0x00, 0x00, 0x00, 0x00, 0x00 // #255 NBSP
};

  // Use font pointer from PROGMEM
  const unsigned char *p = &font[(uint16_t)c * 5];
  
  for (uint8_t col = 0; col < 5; col++) {
    uint8_t bits = pgm_read_byte(p + col);
    for (uint8_t row = 0; row < 8; row++) {
      if (bits & (1 << row)) {
        // Draw pixel directly using screen coordinates
        ssd1315_draw_pixel(x + col, 63-(y + row), 1);
      }
    }
  }
}

void draw_string(uint8_t x, uint8_t y, const char *s) {
  char c;
  // Read byte from Flash and increment pointer 's'
  while ((c = pgm_read_byte(s++))) {
    draw_c(x, y, (unsigned char)c);
    x += 6; // Move cursor right by 6 pixels
  }
}

void setup() {
  i2c_init();
  ssd1315_init();
}

void loop() {
  ssd1315_clear_buffer();
  draw_string(64, 32, PSTR("Hello"));
  ssd1315_update();
}
